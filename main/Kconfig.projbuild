## main/Kconfig.projbuild
```kconfig
menu "Voip App Configuration"

choice VOIP_CODEC
    prompt "SIP Codec"
    default SIP_CODEC_G711A
    help
        sip codec

config SIP_CODEC_G711A
    bool "G711 PCMA"
config SIP_CODEC_G711U
    bool "G711 PCMU"
endchoice

config WIFI_SSID
    string "WiFi SSID"
    default "myssid"
    help
    SSID (network name) for the example to connect to.

config WIFI_PASSWORD
    string "WiFi Password"
    default "mypassword"
    help
    WiFi password (WPA or WPA2) for the example to use.

config SIP_URI
    string "SIP URI"
    default "udp://1004:1234@10.10.34.9:5060"
    help
    The SIP URI with username, password, address, port and transport type

endmenu
```
